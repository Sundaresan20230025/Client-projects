#include <SPI.h>
#include <Wire.h>
#include <Adafruit_GFX.h>
#include <Adafruit_SH1106.h>
#define OLED_RESET     4
#define SCREEN_ADDRESS 0x3C
Adafruit_SH1106 display(OLED_RESET);

#define PIN_ANTENNA A0
#define CHECK_DELAY 1000
#define lmillis() ((long)millis())
const unsigned char zmaj [] PROGMEM = {
  // 'zmaj7 60x60, 128x64px
  0xff, 0xff, 0xff, 0xff, 0xff, 0xff, 0xff, 0xff, 0xff, 0xff, 0xff, 0xff, 0xff, 0xff, 0xff, 0xff,
  0xff, 0xff, 0xff, 0xff, 0xff, 0xff, 0xff, 0xff, 0xff, 0xff, 0xff, 0xff, 0xff, 0xff, 0xff, 0xff,
  0xff, 0xff, 0xff, 0xff, 0xff, 0xff, 0xff, 0xff, 0xff, 0xff, 0xff, 0xff, 0xff, 0xff, 0xff, 0xff,
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  0xff, 0xff, 0xff, 0xff, 0xff, 0xff, 0xff, 0xff, 0xff, 0xff, 0xff, 0xff, 0xff, 0xff, 0xff, 0xff
};

void setup()
{
  Serial.begin(9600);
  pinMode(PIN_ANTENNA, INPUT);

  display.begin(SH1106_SWITCHCAPVCC, SCREEN_ADDRESS);
  display.clearDisplay();
  display.drawBitmap(0, 0, zmaj, 128, 64, WHITE); // display.drawBitmap(x position, y position, bitmap data, bitmap width, bitmap height, color)
  display.display();
  delay(2000);
  display.clearDisplay();
  display.setTextSize(1);
  display.setTextColor(WHITE);
  display.setCursor(22, 10);
  display.println("LTLC");// Print text
  display.setTextSize(2);
  display.setCursor(10, 40);
  display.println("EMF METER");
  display.display();
  delay(2000);
}

void showReadings(int emfValue)
{
  display.clearDisplay();
  display.setTextSize(1);
  display.setTextColor(WHITE);
  display.setCursor(5, 40);
  display.println("EMF:(V/m)");
  display.setCursor(5, 50);
  display.println("HMF:(uT)");
  display.setCursor(90, 50);
  display.println("V:");


  int mf = map(emfValue, 0, 1023, 0, 170);
  int v = map(emfValue, 0, 1023, 0, 330);

  display.setCursor(70, 50);
  display.println(mf);
  if (emfValue < 35) {
    display.setCursor(100, 50);
    display.println(v);
  }
  else {
    display.setCursor(100, 50);
    display.println(v*10);
  }

  display.setCursor(70, 40);
  display.println(emfValue);

  display.display();
}

void loop()
{

  static int avgValue = 0, emfValue = 0;
  static long nextCheck = 0, emfSum = 0, iterations = 0;

  emfValue = constrain(analogRead(PIN_ANTENNA), 0, 1023);
  emfSum += emfValue;
  iterations++;

  if (lmillis() - nextCheck >= 0) {
    avgValue = emfSum / iterations;
    emfSum = 0;
    iterations = 0;
    showReadings(avgValue);
    nextCheck = lmillis() + CHECK_DELAY;
  }
  display.drawRoundRect(0, 5, 126, 30, 2, WHITE);
  display.fillRect(5, 10, 120, 23, BLACK);
  display.fillRect(5, 10, map(emfValue, 0, 1023, 0, 118), 20, WHITE);
  display.display();

  //for buzzer
  if (emfValue > 80 && emfValue < 150) {
    tone (12, 100, 500);
  }
  if (emfValue > 151 && emfValue < 250) {
    tone (12, 500, 500);
  }
  if (emfValue > 251 ) {
    tone (12, 1000, 500);
  }
}
